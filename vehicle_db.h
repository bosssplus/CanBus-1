/******************************************************************************
 * vehicle_db.h — پایگاه داده خودروها
 * ============================================================================
 * توضیحات:
 *   این فایل شامل دیتابیس خودروها با CAN IDهای مربوطه و قابلیت‌های هر خودرو
 *   است. WMI کدها به صورت ۳ کاراکتری ASCII صحیح ذخیره شده‌اند.
 *
 * تغییرات v5.2:
 *   ✅ اصلاح WMI matching — استفاده از ماکرو WMI() به جای اعداد کوچک
 *   ✅ اضافه شدن Capability Flags برای کنترل دسترسی فرمان‌ها
 *   ✅ اصلاح تابع findVehicleByVIN — مقایسه دقیق ۳ بایت اول VIN
 ******************************************************************************/

#ifndef VEHICLE_DB_H
#define VEHICLE_DB_H

#include <stdint.h>
#include <Arduino.h>
#include <cstring>


/* ========================================================================== */
/*   ماکرو تبدیل WMI                                                          */
/* -------------------------------------------------------------------------- */
/*   سه کاراکتر ASCII (مثلاً V, F, 3) را به یک uint32_t 24-bit تبدیل می‌کند */
/*   که با ۳ بایت اول VIN خودرو مطابقت کامل دارد.                             */
/* ========================================================================== */
#define WMI(a, b, c)  ((uint32_t)(a) << 16 | (uint32_t)(b) << 8 | (uint32_t)(c))


/* ========================================================================== */
/*   ساختار VehicleProfile                                                     */
/* ========================================================================== */
typedef struct {

  /* --- شناسه خودرو --- */
  uint32_t  wmi_code;          // WMI کد ۳ بایتی — مثال: WMI('V','F','3')

  /* --- CAN IDهای پیش‌فرض --- */
  uint16_t  can_rpm;           // CAN ID برای دور موتور (RPM)
  uint16_t  can_speed;         // CAN ID برای سرعت
  uint16_t  can_vin;           // CAN ID برای خواندن VIN از طریق UDS
  uint16_t  can_door;          // CAN ID برای وضعیت درب‌ها
  uint16_t  can_fuel;          // CAN ID برای سطح سوخت
  uint16_t  can_temp;          // CAN ID برای دمای موتور

  /* --- مشخصات خودروساز --- */
  const char* make;            // نام خودروساز (برای نمایش)

  /* --- قابلیت‌های پشتیبانی‌شده --- */
  uint32_t  capabilities;      // پرچم‌های قابلیت (OR ترکیبی)

} VehicleProfile;


/* ========================================================================== */
/*   Capability Flags — پرچم‌های قابلیت                                        */
/* -------------------------------------------------------------------------- */
/*   هر خودرو می‌تواند ترکیبی از این قابلیت‌ها را داشته باشد.                 */
/*   فرمان‌ها قبل از اجرا بررسی می‌کنند که خودروی هدف این پرچم را دارد یا نه.  */
/* ========================================================================== */
#define CAP_CAN       (1 << 0)   // قابلیت CAN Bus عادی
#define CAP_OBD2      (1 << 1)   // قابلیت OBD2 diagnostics
#define CAP_UDS       (1 << 2)   // قابلیت UDS (Unified Diagnostic Services)
#define CAP_KWP       (1 << 3)   // قابلیت KWP2000
#define CAP_RF        (1 << 4)   // قابلیت RF (433/315 MHz)
#define CAP_BLE       (1 << 5)   // قابلیت Bluetooth Low Energy
#define CAP_ROLLJAM   (1 << 6)   // قابلیت RollJam (RF جمر)
#define CAP_SNIFFER   (1 << 7)   // قابلیت Sniffer CAN巴士


/* ========================================================================== */
/*   —— دیتابیس خودروها ——                                                    */
/* ========================================================================== */
static const VehicleProfile vehicle_db[] = {

  /* ---------------------------------------------------------------------- */
  /*  پژو / سمند / دنا / پارس — پلتفرم PSA (France)                        */
  /* ---------------------------------------------------------------------- */
  { WMI('V','F','3'),  0x116, 0x116, 0x07DF, 0x326, 0x2C1, 0x5A0,
    "Peugeot (PSA)",   CAP_CAN | CAP_OBD2 | CAP_UDS | CAP_SNIFFER },

  { WMI('V','F','7'),  0x116, 0x116, 0x07DF, 0x326, 0x2C1, 0x5A0,
    "Citroen (PSA)",   CAP_CAN | CAP_OBD2 | CAP_UDS | CAP_SNIFFER },

  { WMI('V','F','1'),  0x116, 0x116, 0x07DF, 0x326, 0x2C1, 0x5A0,
    "Peugeot / Iran",  CAP_CAN | CAP_OBD2 | CAP_UDS },

  /* ---------------------------------------------------------------------- */
  /*  تویوتا — کمری / کرولا / هایلوکس                                      */
  /* ---------------------------------------------------------------------- */
  { WMI('J','T','2'),  0x0C4, 0x0C4, 0x07DF, 0x122, 0x22C, 0x158,
    "Toyota (Japan)",  CAP_CAN | CAP_OBD2 | CAP_UDS | CAP_SNIFFER },

  { WMI('J','T','1'),  0x0C4, 0x0C4, 0x07DF, 0x122, 0x22C, 0x158,
    "Toyota (Japan)",  CAP_CAN | CAP_OBD2 | CAP_UDS },

  /* ---------------------------------------------------------------------- */
  /*  BMW — سری ۳ / ۵ / X-series                                           */
  /* ---------------------------------------------------------------------- */
  { WMI('W','B','A'),  0x0AA, 0x0AA, 0x07DF, 0x30F, 0x2C9, 0x1D0,
    "BMW (Germany)",   CAP_CAN | CAP_OBD2 | CAP_UDS | CAP_SNIFFER },

  { WMI('W','B','S'),  0x0AA, 0x0AA, 0x07DF, 0x30F, 0x2C9, 0x1D0,
    "BMW (Germany)",   CAP_CAN | CAP_OBD2 | CAP_UDS },

  /* ---------------------------------------------------------------------- */
  /*  هیوندای / کیا — کره‌جنوبی                                              */
  /* ---------------------------------------------------------------------- */
  { WMI('K','N','A'),  0x316, 0x316, 0x07DF, 0x124, 0x62C, 0x180,
    "Hyundai",         CAP_CAN | CAP_OBD2 | CAP_UDS },

  { WMI('K','N','B'),  0x316, 0x316, 0x07DF, 0x124, 0x62C, 0x180,
    "Hyundai (N)",     CAP_CAN | CAP_OBD2 | CAP_UDS },

  { WMI('K','N','C'),  0x316, 0x316, 0x07DF, 0x124, 0x62C, 0x180,
    "Kia",             CAP_CAN | CAP_OBD2 | CAP_UDS },

  /* ---------------------------------------------------------------------- */
  /*  شاهین / چانگان — چین (بر اساس openpilot DBC)                          */
  /* ---------------------------------------------------------------------- */
  { WMI('L','S','5'),  0x316, 0x316, 0x07DF, 0x345, 0x62C, 0x180,
    "Changan / Saha (China)",  CAP_CAN | CAP_OBD2 },

  /* ---------------------------------------------------------------------- */
  /*  پایان دیتابیس — مقدار ۰ به عنوان sentinel                              */
  /* ---------------------------------------------------------------------- */
  { 0, 0, 0, 0, 0, 0, 0, nullptr, 0 }

};


/* ========================================================================== */
/*   —— تابع جستجوی خودرو بر اساس VIN ——                                       */
/* -------------------------------------------------------------------------- */
/*   ورودی:  رشته VIN به طول حداقل ۳ کاراکتر                                  */
/*   خروجی:  پوینتر به VehicleProfile یا nullptr در صورت عدم یافت              */
/* ========================================================================== */
inline const VehicleProfile* findVehicleByVIN(const char* vin) {

  /* ---- اعتبارسنجی ورودی ---- */
  if (!vin || strlen(vin) < 3) {
    return nullptr;
  }

  /* ---- استخراج WMI از ۳ بایت اول VIN ---- */
  uint32_t wmi = ((uint32_t)(vin[0]) << 16) |
                 ((uint32_t)(vin[1]) <<  8) |
                 ((uint32_t)(vin[2]));

  /* ---- جستجو در دیتابیس ---- */
  for (int i = 0; vehicle_db[i].make != nullptr; i++) {
    if (vehicle_db[i].wmi_code == wmi) {
      return &vehicle_db[i];
    }
  }

  return nullptr;  // ❌ خودرو در دیتابیس یافت نشد
}


/* ========================================================================== */
/*   —— تابع جستجوی خودرو بر اساس WMI کد ۳ بایتی ——                            */
/* -------------------------------------------------------------------------- */
/*   ورودی:  WMI کد ۳ بایتی (مانند 0x564633 برای "VF3")                       */
/*   خروجی:  پوینتر به VehicleProfile یا nullptr                               */
/* ========================================================================== */
inline const VehicleProfile* findVehicleByWMI(uint32_t wmi_3byte) {

  for (int i = 0; vehicle_db[i].make != nullptr; i++) {
    if (vehicle_db[i].wmi_code == wmi_3byte) {
      return &vehicle_db[i];
    }
  }

  return nullptr;
}


#endif  /* VEHICLE_DB_H */
